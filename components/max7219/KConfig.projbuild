## components/max7219/KConfig.projbuild
```kconfig
menu "Example Configuration"
    config EXAMPLE_SPI_MOSI
        int "SPI MOSI Pin"
        default 13
    config EXAMPLE_SPI_SCK
        int "SPI Clock Pin"
        default 14
    config EXAMPLE_SPI_CS
        int "SPI CS Pin"
        default 15
endmenu
```
